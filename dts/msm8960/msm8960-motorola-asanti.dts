// SPDX-License-Identifier: GPL-2.0-only

/dts-v1/;

#include <skeleton.dtsi>
#include <lk2nd.h>

/ {
	// This is used by the bootloader to find the correct DTB
	qcom,msm-id = <194 118 0x10001>;

	model = "Motorola Photon Q (XT897)";
	compatible = "mmi,asanti", "qcom,msm8960", "lk2nd,device";
	lk2nd,match-cmdline = "* androidboot.bootloader=0x109B *";

	lk2nd,keys =
		<KEY_VOLUMEUP   PM_GPIO(5) PM_GPIO_PULL_UP_1_5>,
		<KEY_VOLUMEDOWN PM_GPIO(3) PM_GPIO_PULL_UP_1_5>;
};
